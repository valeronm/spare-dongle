## CMakeLists.txt
```
cmake_minimum_required(VERSION 3.20.0)

find_package(Zephyr REQUIRED HINTS $ENV{ZEPHYR_BASE})
project(spare_dongle)

set(manifest ${CMAKE_CURRENT_SOURCE_DIR}/tool/Cargo.toml)
set_property(DIRECTORY APPEND PROPERTY CMAKE_CONFIGURE_DEPENDS ${manifest})
file(STRINGS ${manifest} version_line REGEX "^version = \"[0-9]+\\.[0-9]+\\.[0-9]+\"$" LIMIT_COUNT 1)
if(NOT version_line MATCHES "([0-9]+)\\.([0-9]+)\\.([0-9]+)")
  message(FATAL_ERROR "no version line in ${manifest}")
endif()
set_property(SOURCE src/core.c APPEND PROPERTY COMPILE_DEFINITIONS
  FIRMWARE_VERSION_MAJOR=${CMAKE_MATCH_1} FIRMWARE_VERSION_MINOR=${CMAKE_MATCH_2}
  FIRMWARE_VERSION_PATCH=${CMAKE_MATCH_3})

target_sources(app PRIVATE
  src/main.c src/core.c src/nuphy_main.c src/unifying_main.c src/radio.c src/noise.c src/usb.c
  src/indicator.c src/nuphy.c src/unifying.c src/protocol.c src/reports.c src/chanpick.c
  src/link.c src/store.c src/diag.c src/history.c src/pairwin.c src/chanwatch.c
  src/ble.c src/bluetooth_main.c src/hidmap.c src/hidkeys.c src/hidpp.c
  src/btpolicy.c src/btpair.c src/btlist.c src/btseen.c src/bootinfo.c src/blink.c)

include(ffi/diagwire.cmake)
# CONFIG_FPU is off, so the firmware uses the soft-float ABI.
diagwire_build(thumbv7em-none-eabi)
target_link_libraries(app PRIVATE diagwire)
```

## prj.conf
```kconfig
CONFIG_SERIAL=y
CONFIG_CONSOLE=y
CONFIG_UART_CONSOLE=y
CONFIG_UART_LINE_CTRL=y
CONFIG_PRINTK=y
CONFIG_USB_DEVICE_STACK_NEXT=y
CONFIG_CDC_ACM_SERIAL_INITIALIZE_AT_BOOT=n
CONFIG_USBD_CDC_ACM_CLASS=y
CONFIG_USBD_HID_SUPPORT=y
CONFIG_HWINFO=y
CONFIG_REBOOT=y
CONFIG_MAIN_STACK_SIZE=2048
CONFIG_ESB=y
CONFIG_CLOCK_CONTROL=y
CONFIG_ESB_CLOCK_INIT=y
CONFIG_FLASH=y
CONFIG_FLASH_MAP=y
CONFIG_NVS=y
CONFIG_SETTINGS=y
CONFIG_SETTINGS_NVS=y
CONFIG_WATCHDOG=y
CONFIG_ENTROPY_GENERATOR=y
CONFIG_ESB_DYNAMIC_INTERRUPTS=y
CONFIG_MPSL_DYNAMIC_INTERRUPTS=y
CONFIG_BT=y
CONFIG_BT_CENTRAL=y
CONFIG_BT_SMP=y
CONFIG_BT_SETTINGS=y
CONFIG_BT_GATT_CLIENT=y
CONFIG_BT_GATT_DM=y
CONFIG_BT_HOGP=y
CONFIG_BT_MAX_CONN=4
# The host answers a device's connection parameter request with a command it waits on from the
# thread that frees received data, and the controller delivers that reply only after ACL data it
# could not hand over for lack of buffers.
CONFIG_BT_HCI_ACL_FLOW_CONTROL=y
CONFIG_BT_BUF_CMD_TX_COUNT=6
CONFIG_BT_MAX_PAIRED=8
CONFIG_BT_DEVICE_NAME="SpareDongle"
CONFIG_HEAP_MEM_POOL_SIZE=2048
CONFIG_SYSTEM_WORKQUEUE_STACK_SIZE=2048
# Every link's HID client draws its reports from this one pool.
CONFIG_BT_HOGP_REPORTS_MAX=64
CONFIG_BT_GATT_DM_MAX_ATTRS=80
CONFIG_BT_SMP_SC_PAIR_ONLY=n
CONFIG_BT_ATT_TX_COUNT=17
CONFIG_BT_BAS_CLIENT=y
CONFIG_BT_SCAN_WITH_IDENTITY=y
CONFIG_BT_APP_PASSKEY=y
# Zephyr marks it experimental, which the build warns about.
CONFIG_BT_PASSKEY_KEYPRESS=y
CONFIG_BT_CTLR_CONN_RSSI=y
CONFIG_BT_USER_PHY_UPDATE=y
CONFIG_BT_HCI_VS_EVT_USER=y
# A report that finds the host's event buffers full stalls the host unless the fix in
# patches/nrf counts it as discardable.
CONFIG_BT_CTLR_SDC_QOS_CHANNEL_SURVEY=y
# Every link sets this much of each connection interval aside.
CONFIG_BT_CTLR_SDC_MAX_CONN_EVENT_LEN_DEFAULT_OVERRIDE=y
CONFIG_BT_CTLR_SDC_MAX_CONN_EVENT_LEN_DEFAULT=1250
```

## src/main.c
```c
#include <hal/nrf_timer.h>
#include <zephyr/drivers/hwinfo.h>
#include <zephyr/init.h>
#include <zephyr/sys/printk.h>
#include "bootinfo.h"
#include "core.h"
#include "store.h"

/* The SoftDevice sits above the 4 kB MBR and keeps its information structure 0x2000 into itself. */
#define SD_INFO_ADDRESS 0x3000

static uint32_t bootloader_version_register;

/* TIMER2's CC[0] holds the bootloader's version only until a driver or radio stack reuses the
 * timer, and PRE_KERNEL_1 runs before any of them start. */
static int capture_bootloader_version(void)
{
	bootloader_version_register = nrf_timer_cc_get(NRF_TIMER2, NRF_TIMER_CC_CHANNEL0);
	return 0;
}

SYS_INIT(capture_bootloader_version, PRE_KERNEL_1, 0);

int main(void)
{
	uint32_t reset_cause = 0;
	uint8_t stored = 0;
	bool loaded = false;
	bool save;
	enum protocol active;
	struct bootinfo boot;
	int store_err;

	hwinfo_get_reset_cause(&reset_cause);
	hwinfo_clear_reset_cause();
	bootinfo_read(&boot, reset_cause, bootloader_version_register,
		      (const uint8_t *)SD_INFO_ADDRESS);
	store_err = store_init();
	if (store_err) {
		printk("store init failed: %d\n", store_err);
	} else {
		loaded = store_load_protocol(&stored);
	}
	active = protocol_from_stored(loaded, stored, &save);
	if (!store_err && save) {
		int save_err = store_save_protocol(active);

		if (save_err) {
			printk("protocol save failed: %d\n", save_err);
		}
	}
	core_start(active, &boot);
	if (active == PROTOCOL_BLUETOOTH) {
		bluetooth_run(store_err);
	}
	if (active == PROTOCOL_UNIFYING) {
		unifying_run(store_err);
	}
	nuphy_run(store_err);
	return 0;
}
```

## src/ble.h
```c
#ifndef BLE_H
#define BLE_H

#include <stdbool.h>
#include <stddef.h>
#include <stdint.h>

#include <zephyr/kernel.h>

#include "btpolicy.h"
#include "noise.h"

struct diag_status;

#define BLE_REPORT_MAX 64
#define BLE_MAP_MAX 1024
#define BLE_NAME_MAX BTPOLICY_NAME_MAX
#define BLE_ADDRESS_MAX 30
#define BLE_REASON_NOT_ESTABLISHED 0x3e

enum ble_event_type {
	BLE_ADVERT,
	BLE_CONNECTED,
	BLE_DISCONNECTED,
	BLE_FAILED,
	BLE_PAIRED,
	/* The device waits for the offered passkey to be typed on it. */
	BLE_PASSKEY_AWAITED,
	/* The device reported a key or click of the passkey. */
	BLE_KEYPRESS,
	BLE_MAP_READ,
	BLE_REPORT,
	BLE_BATTERY,
	BLE_FORGOTTEN,
};

enum ble_stage {
	BLE_STAGE_CONNECT,
	BLE_STAGE_SECURITY,
	BLE_STAGE_DISCOVERY,
	BLE_STAGE_HID_SETUP,
	BLE_STAGE_MAP,
	BLE_STAGE_SUBSCRIBE,
};

struct ble_event {
	enum ble_event_type type;
	/* The slot the event is about; unset for BLE_ADVERT, and DEVICE_NO_SLOT for a BLE_FORGOTTEN
	 * device no slot held. */
	uint8_t slot;
	union {
		/* BLE_ADVERT: from a stored device or one offering the HID service. */
		struct btpolicy_advert advert;
		/* BLE_CONNECTED: the device's address as text. */
		char address[BLE_ADDRESS_MAX];
		/* BLE_DISCONNECTED: the stack's reason code, BLE_REASON_NOT_ESTABLISHED when the
		 * device never joined the connection. */
		uint8_t reason;
		/* BLE_FAILED */
		struct {
			enum ble_stage stage;
			int error;
			enum btpolicy_failure why;
		} failed;
		/* BLE_PAIRED: whether the device was typed the offered passkey and took the Bolt mode write. */
		struct {
			bool passkey_used;
			bool bolt_mode;
		} paired;
		/* BLE_PASSKEY_AWAITED: the passkey the device was given. */
		struct {
			uint32_t value;
			bool clicked;
		} passkey;
		enum btpolicy_keypress keypress;
		/* BLE_REPORT: the bytes exclude the report ID. */
		struct {
			uint32_t received_us;
			uint8_t id;
			uint8_t len;
			uint8_t data[BLE_REPORT_MAX];
		} report;
		/* BLE_BATTERY: the level is unknown once it cannot be read. */
		struct device_battery battery;
		/* BLE_FORGOTTEN: the stack's error, and the tag ble_forget was given. */
		struct {
			uint8_t addr[BTPOLICY_ADDR_LEN];
			uint8_t tag;
			int error;
		} forgotten;
	};
};

/* Starts the Bluetooth stack; a second call fails with -EALREADY once the first has run. */
int ble_start(void);
/* Does nothing when scanning is already in the mode asked for; an active scan asks every
 * advertiser for its scan response. */
int ble_scan(enum btpolicy_scan mode);
/* Every call that returns 0 ends in one BLE_DISCONNECTED for the slot, after a BLE_FAILED when a
 * stage failed. */
int ble_connect(uint8_t slot, const uint8_t addr[BTPOLICY_ADDR_LEN],
		const char *advertised_name, bool clicks);
/* While on, a keyboard able to take a passkey is asked for this six-digit one as it pairs, and a
 * device connected with clicks is told it pairs with a Bolt receiver and asked for its low
 * DIAG_CLICK_PASSKEY_BITS. */
int ble_offer_passkey(bool on, uint32_t value);
uint8_t ble_stored_count(void);
/* Copies up to cap bonded addresses and returns how many bonds there are. */
uint8_t ble_stored(uint8_t addrs[][BTPOLICY_ADDR_LEN], uint8_t cap);
/* Deletes the device's bond through store_run, disconnecting it first if it is connected, and
 * reports BLE_FORGOTTEN; the device's adverts are dropped until then. Returns -ENOMEM while too
 * many deletes wait. */
int ble_forget(uint8_t slot, const uint8_t addr[BTPOLICY_ADDR_LEN], uint8_t tag);
bool ble_take_event(struct ble_event *ev, k_timeout_t wait);
/* Copies the report map read at the slot's connection and returns its length, 0 before its
 * BLE_MAP_READ. */
size_t ble_copy_map(uint8_t slot, uint8_t *out, size_t cap);
/* The name of the slot's device, the advertised one until its own is read; empty if it gave
 * none. */
void ble_copy_name(uint8_t slot, char out[BLE_NAME_MAX + 1]);
/* The link's parameters and the device's last request on it, all zero with no link. */
void ble_fill_link(uint8_t slot, struct diag_status *st);
void ble_disconnect(uint8_t slot);
/* Disconnects as a host that is powering off does. */
void ble_power_off(uint8_t slot);
/* Writes the slot's output report with this ID, data excluding the ID; fails until the device's
 * reports are discovered and while an earlier write to that report is still being sent. */
int ble_write_report(uint8_t slot, uint8_t report_id, const uint8_t *data, uint8_t len);
/* Reads the slot's signal from the controller; fails with -ENOTCONN without a device and -ENODATA
 * when the controller has no reading yet. */
int ble_rssi(uint8_t slot, int8_t *dbm);
/* Whether the bond with the device was made by LE Secure Connections, not legacy pairing; false
 * for an address without a bond. */
bool ble_bond_secure(const uint8_t addr[BTPOLICY_ADDR_LEN]);
const char *ble_stage_name(enum ble_stage stage);
/* Takes the energy read on the data channels since the last call; it always counts toward the
 * minute, since the links hop over every data channel; *home is always CHANMOVE_NO_HOME. */
bool ble_take_noise(struct noise_tally *t, int *home);

#endif
```

## src/blink.c
```c
#include "blink.h"

enum indicator_mode blink_mode(struct blink_state s)
{
	/* A radio that failed to start stays failed when the PC wakes. */
	if (s.radio_failed) {
		return IND_ERROR;
	}
	if (s.usb_suspended) {
		return IND_SLEEP;
	}
	if (s.pairing_open) {
		return IND_PAIRING;
	}
	return s.connected ? IND_CONNECTED : IND_IDLE;
}

bool blink_lit(enum indicator_mode mode, uint32_t step)
{
	switch (mode) {
	case IND_IDLE:
		return step % 20 == 0;
	case IND_PAIRING:
		return step % 4 < 2;
	case IND_CONNECTED:
		return true;
	case IND_SLEEP:
		return false;
	case IND_ERROR:
		return step % 40 < 6 && step % 2 == 0;
	}
	return false;
}
```

## src/blink.h
```c
#ifndef BLINK_H
#define BLINK_H

#include <stdbool.h>
#include <stdint.h>

#define BLINK_STEP_MS 50

enum indicator_mode {
	IND_IDLE,
	IND_PAIRING,
	IND_CONNECTED,
	IND_SLEEP,
	IND_ERROR,
};

struct blink_state {
	bool radio_failed;
	bool usb_suspended;
	bool pairing_open;
	bool connected;
};

enum indicator_mode blink_mode(struct blink_state s);

/* step counts BLINK_STEP_MS periods from when the indicator started. */
bool blink_lit(enum indicator_mode mode, uint32_t step);

#endif
```

## src/bluetooth_main.c
```c
#include <string.h>
#include <zephyr/kernel.h>
#include <zephyr/random/random.h>
#include <zephyr/sys/printk.h>
#include "ble.h"
#include "btlist.h"
#include "btpair.h"
#include "btpolicy.h"
#include "core.h"
#include "diag.h"
#include "hidkeys.h"
#include "hidmap.h"
#include "hidpp.h"
#include "store.h"
#include "usb.h"

#define TICK_MS 10
#define RSSI_PERIOD_MS 1000
/* A device reached over Bluetooth answers HID++ as its own receiver. */
#define HIDPP_DEVICE_INDEX 0xff
#define HIDPP_RETRY_MS 1000

static int no_home(void)
{
	return CHANMOVE_NO_HOME;
}

static void nothing(void)
{
}

static uint8_t map_bytes[BLE_MAP_MAX];
static struct hidmap maps[DEVICE_SLOTS];
static struct btpolicy policy;
static struct btlist list;
static struct btpair pair;

/* What the dongle learns of a connected device; it starts over at each connection. */
struct connected {
	char name[BLE_NAME_MAX + 1];
	/* From the Battery Service. */
	uint8_t level;
	/* From HID++, the only source of the charging state. */
	struct device_battery battery;
	/* The consumer usages the device's reports and its diverted keys each hold. */
	uint16_t media_usage;
	uint16_t divert_usage;
	int wheel_carry;
	bool rssi_read;
	int8_t rssi;
	bool reported;
	uint32_t report_ms;
	struct hidkeys keys;
	/* A button already down when the connection starts was pressed for something before it, such
	 * as closing a clicked passkey. */
	bool buttons_muted;
};

static struct connected devices[DEVICE_SLOTS];

/* A device's feature indexes are fixed by its firmware, so a run is kept while the same address
 * reconnects. */
static struct {
	uint8_t addr[BTPOLICY_ADDR_LEN];
	struct hidpp hidpp;
} runs[DEVICE_SLOTS];
static uint32_t rssi_tried_ms;

static void connection_over(uint8_t slot)
{
	devices[slot] = (struct connected){
		.level = DEVICE_NO_BATTERY,
		.battery = DEVICE_BATTERY_UNKNOWN,
		.buttons_muted = true,
	};
}

/* A HID++ level replaces the Battery Service's, which a device can keep reporting while HID++
 * calls its level unknown. */
static struct device_battery battery_of(const struct connected *c)
{
	struct device_battery b = c->battery;

	if (b.level == DEVICE_NO_BATTERY) {
		b.level = c->level;
	}
	return b;
}

static void slots(struct diag_slot *out)
{
	for (uint8_t s = 0; s < DEVICE_SLOTS; s++) {
		const uint8_t *last = btpolicy_last_peer(&policy, s);

		out[s] = (struct diag_slot){
			.kind = last ? btpolicy_slot_kind(&policy, s) : DEVICE_KIND_KEYBOARD,
			.stored = btlist_has(&list, last),
			.ready = btpolicy_is_ready(&policy, s),
			.standby = btpolicy_is_standby(&policy, s),
		};
	}
}

static uint8_t pairing_of(uint8_t slot)
{
	const struct btlist_entry *e;

	if (!btpolicy_is_ready(&policy, slot)) {
		return 0;
	}
	e = btlist_entry(&list, btpolicy_peer(&policy, slot));
	if (!e) {
		return 0;
	}
	return btlist_pairing(e, ble_bond_secure(e->addr));
}

static void fill_status(struct diag_status *st, uint8_t slot)
{
	const struct connected *c = &devices[slot];
	btpair_status(&pair, k_uptime_get_32(), st);
	st->pairing = pairing_of(slot);
	st->battery = battery_of(c);
	ble_fill_link(slot, st);
	if (c->rssi_read) {
		st->last_rssi = c->rssi;
	}
	if (c->reported) {
		st->last_rx_age_ms = k_uptime_get_32() - c->report_ms;
	}
	if (btpolicy_is_ready(&policy, slot)) {
		strncpy((char *)st->name, c->name, sizeof(st->name));
	} else {
		const struct btlist_entry *e =
			btlist_entry(&list, btpolicy_last_peer(&policy, slot));

		if (e) {
			memcpy(st->name, e->name, sizeof(st->name));
		}
	}
}

static size_t no_candidates(const uint8_t **channels)
{
	static const uint8_t none[1];

	*channels = none;
	return 0;
}

static enum chanmove_result no_move(uint8_t channel, uint8_t *from)
{
	ARG_UNUSED(channel);
	*from = 0;
	return CHANMOVE_NOT_MOVABLE;
}

/* Losing its link is the only notice of a suspend some keyboards act on. */
static void host_suspended(bool suspended)
{
	if (!suspended) {
		return;
	}
	for (uint8_t s = 0; s < DEVICE_SLOTS; s++) {
		if (btpolicy_peer(&policy, s)) {
			btpolicy_dropping(&policy, s);
			ble_power_off(s);
		}
	}
}

static bool pairing(void)
{
	return btpair_is_open(&pair, k_uptime_get_32());
}

static const struct core_loop loop = {
	.home = no_home,
	.take_noise = ble_take_noise,
	.radio_resumed = nothing,
	.slot_count = DEVICE_SLOTS,
	.slots = slots,
	.fill_status = fill_status,
	.movable = no_home,
	.candidates = no_candidates,
	.replies_dropped = nothing,
	.move = no_move,
	.host_suspended = host_suspended,
	.pairing = pairing,
};

static const char *map_fault(enum hidmap_result result)
{
	switch (result) {
	case HIDMAP_MALFORMED:
		return "malformed";
	case HIDMAP_TOO_LARGE:
		return "too large";
	case HIDMAP_NO_KEYBOARD:
		return "without a keyboard";
	case HIDMAP_NO_POINTER:
		return "without a pointer";
	case HIDMAP_OK:
		break;
	}
	return "usable";
}

static void save_list(bool changed)
{
	if (changed) {
		store_save_bluetooth(&list);
	}
}

/* Bonds decide which devices are listed; the list adds their kinds, names, passkey mark and
 * order. */
static void load_list(void)
{
	uint8_t bonded[BTPOLICY_STORED_MAX][BTPOLICY_ADDR_LEN];
	uint8_t n = ble_stored(bonded, BTPOLICY_STORED_MAX);

	if (!store_load_bluetooth(&list) || list.count > BTPOLICY_STORED_MAX) {
		list = (struct btlist){0};
	}
	save_list(btlist_reconcile(&list, bonded, MIN(n, BTPOLICY_STORED_MAX)));
}

/* The cause is a HISTORY_FORGOTTEN_* value, logged once the bond is deleted. */
static int forget(uint8_t slot, const uint8_t *addr, uint8_t cause)
{
	int err = ble_forget(slot, addr, cause);

	if (err) {
		printk("bluetooth bond not queued for deletion: %d\n", err);
	}
	return err;
}

static void log_forgotten(uint8_t slot, const uint8_t *addr, uint8_t cause)
{
	core_log_address(slot,
			 (struct diag_detail){.tag = DIAG_DETAIL_BT_FORGOTTEN,
					      .BT_FORGOTTEN = {.cause = cause}},
			 addr);
}

/* The tool's forget is answered once the bond's delete is done. */
static struct diag_request forget_request;
static bool forget_answering;

static void answer_forget(const uint8_t *addr, int error)
{
	if (!forget_answering || memcmp(forget_request.data, addr, BTPOLICY_ADDR_LEN) != 0) {
		return;
	}
	forget_answering = false;
	if (error) {
		diag_reply_error(&forget_request, DIAG_ERROR_STORE, 0);
	} else {
		diag_reply(&forget_request, NULL, 0, DIAG_AFTER_NONE);
	}
}

static void on_forgotten(const struct ble_event *ev)
{
	const uint8_t *addr = ev->forgotten.addr;

	answer_forget(addr, ev->forgotten.error);
	if (ev->forgotten.error) {
		printk("bluetooth bond not deleted: %d\n", ev->forgotten.error);
		core_log_address(ev->slot, (struct diag_detail){.tag = DIAG_DETAIL_BT_NOT_FORGOTTEN},
				 addr);
		return;
	}
	save_list(btlist_remove(&list, addr));
	btpolicy_forgotten(&policy, addr);
	log_forgotten(ev->slot, addr, ev->forgotten.tag);
}

BUILD_ASSERT(DIAG_REQUEST_DATA_LEN == BTPOLICY_ADDR_LEN);

static void log_device(struct diag_detail d, uint8_t slot)
{
	core_log_address(slot, d, btpolicy_peer(&policy, slot));
}

static void send_leds(uint8_t leds)
{
	for (uint8_t s = 0; s < DEVICE_SLOTS; s++) {
		const struct hidmap *map = &maps[s];
		int err;

		if (!btpolicy_is_ready(&policy, s) ||
		    btpolicy_slot_kind(&policy, s) != DEVICE_KIND_KEYBOARD || !map->has_leds) {
			continue;
		}
		err = ble_write_report(s, map->led_report_id, &leds, sizeof(leds));
		if (err) {
			printk("bluetooth leds not sent to link %u: %d\n", s, err);
		}
	}
}

static void on_advert(const struct btpolicy_advert *heard)
{
	struct btpolicy_advert a = *heard;
	uint32_t now = k_uptime_get_32();
	struct btpolicy_choice c;
	int err;

	if (a.stored) {
		a.kind = btlist_kind(&list, a.addr);
	}
	c = btpair_wants(&pair, &policy, &a, now);
	switch (c.want) {
	case BTPOLICY_IGNORE:
		return;
	case BTPOLICY_REPLACE:
		btpolicy_dropping(&policy, c.slot);
		ble_disconnect(c.slot);
		return;
	case BTPOLICY_CONNECT:
		break;
	}
	ble_scan(BTPOLICY_SCAN_OFF);
	err = ble_connect(c.slot, a.addr, a.name, btpolicy_pairs_by_clicks(a.kind, a.bolt));
	if (err) {
		printk("bluetooth connect not started: %d\n", err);
		return;
	}
	btpolicy_connecting(&policy, c.slot, &a);
}

static void attempt_failed(uint8_t slot, bool refused)
{
	if (btpair_attempt_failed(&pair, slot, refused, k_uptime_get_32())) {
		core_log_pairing_closed();
	}
}

static void on_failed(const struct ble_event *ev)
{
	enum btpolicy_security outcome;

	printk("bluetooth %s failed: %d\n", ble_stage_name(ev->failed.stage), ev->failed.error);
	if (ev->failed.stage != BLE_STAGE_SECURITY) {
		return;
	}
	outcome = btpolicy_security_failed(&policy, ev->slot, ev->failed.why);
	switch (outcome) {
	case BTPOLICY_PAIRING_REFUSED:
		printk("bluetooth pairing refused\n");
		core_log(ev->slot,
			 (struct diag_detail){.tag = DIAG_DETAIL_BT_REFUSED,
					       .BT_REFUSED = {.refused = HISTORY_REFUSED_BY_KEYBOARD}});
		break;
	case BTPOLICY_BOND_LOST:
		printk("bluetooth device lost its bond\n");
		log_device((struct diag_detail){.tag = DIAG_DETAIL_BT_BOND_LOST}, ev->slot);
		break;
	case BTPOLICY_SECURITY_FAILED:
		break;
	}
	attempt_failed(ev->slot, outcome == BTPOLICY_PAIRING_REFUSED);
}

static void device_ready(uint8_t slot)
{
	btpolicy_ready(&policy, slot);
	log_device((struct diag_detail){.tag = DIAG_DETAIL_BT_CONNECTED}, slot);
	save_list(btlist_connected(&list, btpolicy_peer(&policy, slot), devices[slot].name));
}

static void on_map_read(uint8_t slot)
{
	enum device_kind kind = btpolicy_slot_kind(&policy, slot);
	const char *what = device_kind_name(kind);
	char *name = devices[slot].name;
	size_t len;
	enum hidmap_result result;

	ble_copy_name(slot, name);
	len = ble_copy_map(slot, map_bytes, sizeof(map_bytes));
	result = hidmap_parse(map_bytes, len, kind, &maps[slot]);
	if (result != HIDMAP_OK) {
		printk("bluetooth %s \"%s\" refused: report map %s\n", what, name,
		       map_fault(result));
		if (result == HIDMAP_NO_KEYBOARD || result == HIDMAP_NO_POINTER) {
			forget(slot, btpolicy_peer(&policy, slot), HISTORY_FORGOTTEN_UNUSABLE_MAP);
		}
		ble_disconnect(slot);
		return;
	}
	printk("bluetooth %s \"%s\" ready\n", what, name);
	device_ready(slot);
	if (maps[slot].has_hidpp) {
		const uint8_t *peer = btpolicy_peer(&policy, slot);

		if (memcmp(runs[slot].addr, peer, BTPOLICY_ADDR_LEN) != 0) {
			hidpp_init(&runs[slot].hidpp, kind);
			memcpy(runs[slot].addr, peer, BTPOLICY_ADDR_LEN);
		}
		hidpp_start(&runs[slot].hidpp);
	}
	if (kind == DEVICE_KIND_KEYBOARD) {
		uint8_t leds;

		core_take_leds(&leds);
		send_leds(leds);
	}
}

static void release_slot(uint8_t slot)
{
	const struct connected *c = &devices[slot];

	core_release_device(btpolicy_slot_kind(&policy, slot),
			    c->media_usage != 0 || c->divert_usage != 0);
}

static bool take_input(uint8_t slot, bool pressed)
{
	struct btpolicy_input_result r = btpolicy_input(&policy, slot, pressed);

	if (r.input == BTPOLICY_INPUT_TOOK_OVER) {
		release_slot(r.released);
		log_device((struct diag_detail){.tag = DIAG_DETAIL_BT_ACTIVE}, slot);
	}
	return r.input != BTPOLICY_INPUT_STANDBY;
}

static void on_disconnected(uint8_t slot, uint8_t reason)
{
	uint8_t promoted;

	if (btpolicy_is_ready(&policy, slot)) {
		core_log(slot,
			 (struct diag_detail){.tag = DIAG_DETAIL_BT_DISCONNECTED,
					       .BT_DISCONNECTED = {.reason = reason,
								   .since_input_s = core_since_input_s(slot)}});
	}
	if (btpolicy_is_active(&policy, slot)) {
		release_slot(slot);
	}
	attempt_failed(slot, false);
	connection_over(slot);
	promoted = btpolicy_disconnected(&policy, slot, k_uptime_get_32(),
					 reason == BLE_REASON_NOT_ESTABLISHED);
	if (promoted != DEVICE_NO_SLOT) {
		log_device((struct diag_detail){.tag = DIAG_DETAIL_BT_ACTIVE}, promoted);
	}
}

static size_t mouse_report(uint8_t slot, const struct ble_event *ev, struct report *out)
{
	struct connected *c = &devices[slot];
	int wheel;

	if (!hidkeys_pointer(&maps[slot].pointer, ev->report.id, ev->report.data, ev->report.len,
			     out)) {
		return 0;
	}
	wheel = reports_scale_wheel(&c->wheel_carry, out->mouse.wheel,
				    hidpp_wheel_steps(&runs[slot].hidpp), usb_mouse_wheel_steps());
	out->mouse.wheel = (int8_t)reports_clamp(wheel, -INT8_MAX, INT8_MAX);
	reports_mute_buttons(&c->buttons_muted, out);
	return 1;
}

static size_t keyboard_reports(uint8_t slot, const struct ble_event *ev, struct report *out)
{
	struct connected *c = &devices[slot];
	size_t n = hidkeys_translate(&c->keys, &maps[slot], ev->report.id, ev->report.data,
				     ev->report.len, out);

	for (size_t i = 0; i < n; i++) {
		if (out[i].kind == REPORT_CONSUMER) {
			c->media_usage = out[i].usage;
			out[i] = reports_consumer(out[i].usage, c->divert_usage);
		}
	}
	return n;
}

static void print_battery(enum device_kind kind, struct device_battery b)
{
	if (b.level == DEVICE_NO_BATTERY) {
		printk("bluetooth %s battery unknown, charging state %d\n", device_kind_name(kind),
		       b.charging);
	} else {
		printk("bluetooth %s battery %u%%, charging state %d\n", device_kind_name(kind),
		       b.level, b.charging);
	}
}

static void on_hidpp_report(const struct ble_event *ev)
{
	uint8_t slot = ev->slot;
	struct connected *c = &devices[slot];
	struct device_battery before = c->battery;
	struct hidpp_msg m;
	uint16_t usage;

	hidpp_msg_read(ev->report.data, ev->report.len, true, &m);
	if (hidpp_rx(&runs[slot].hidpp, &c->battery, &m, &usage) && usage != c->divert_usage) {
		const struct report out = reports_consumer(usage, c->media_usage);

		c->divert_usage = usage;
		if (take_input(slot, usage != 0)) {
			core_submit(slot, &out, &ev->report.received_us);
		}
	}
	if (before.level != c->battery.level || before.charging != c->battery.charging) {
		print_battery(btpolicy_slot_kind(&policy, slot), battery_of(c));
	}
}

static void on_report(const struct ble_event *ev)
{
	struct report out[REPORT_KINDS];
	uint8_t slot = ev->slot;
	size_t n;

	if (!btpolicy_is_ready(&policy, slot)) {
		return;
	}
	core_packet(slot);
	devices[slot].reported = true;
	devices[slot].report_ms = k_uptime_get_32();
	if (maps[slot].has_hidpp && ev->report.id == HIDPP_LONG_REPORT_ID &&
	    ev->report.len == HIDPP_LONG_LEN) {
		on_hidpp_report(ev);
		return;
	}
	n = btpolicy_slot_kind(&policy, slot) == DEVICE_KIND_MOUSE ? mouse_report(slot, ev, out)
								    : keyboard_reports(slot, ev, out);
	if (!take_input(slot, reports_pressed(out, n))) {
		return;
	}
	for (size_t i = 0; i < n; i++) {
		core_submit(slot, &out[i], &ev->report.received_us);
	}
}

static void on_event(const struct ble_event *ev)
{
	char name[BLE_NAME_MAX + 1];

	switch (ev->type) {
	case BLE_ADVERT:
		on_advert(&ev->advert);
		break;
	case BLE_CONNECTED:
		printk("bluetooth connected: %s\n", ev->address);
		btpolicy_connected(&policy, ev->slot);
		break;
	case BLE_DISCONNECTED:
		printk("bluetooth disconnected: reason 0x%02x\n", ev->reason);
		on_disconnected(ev->slot, ev->reason);
		break;
	case BLE_FAILED:
		on_failed(ev);
		break;
	case BLE_PAIRED:
		btpair_paired(&pair, &policy, ev->slot);
		core_slot_paired(ev->slot);
		printk("bluetooth paired\n");
		log_device((struct diag_detail){.tag = DIAG_DETAIL_BT_PAIRED, .BT_PAIRED = {.passkey = ev->paired.passkey_used}},
			   ev->slot);
		ble_copy_name(ev->slot, name);
		save_list(btlist_paired(&list, btpolicy_peer(&policy, ev->slot),
					btpolicy_slot_kind(&policy, ev->slot),
					ev->paired.passkey_used, ev->paired.bolt_mode, name));
		break;
	case BLE_PASSKEY_AWAITED:
		ble_copy_name(ev->slot, name);
		if (btpair_passkey_awaited(&pair, ev->slot, ev->passkey.value, ev->passkey.clicked,
					   name, k_uptime_get_32())) {
			printk("bluetooth passkey awaited by \"%s\"\n", name);
			log_device((struct diag_detail){.tag = DIAG_DETAIL_BT_PASSKEY_AWAITED}, ev->slot);
		}
		break;
	case BLE_KEYPRESS:
		if (btpair_keypress(&pair, ev->slot, ev->keypress)) {
			printk("bluetooth keypress %d, %u entered\n", ev->keypress,
			       pair.passkey.entered);
		}
		break;
	case BLE_MAP_READ:
		on_map_read(ev->slot);
		break;
	case BLE_REPORT:
		on_report(ev);
		break;
	case BLE_BATTERY:
		devices[ev->slot].level = ev->battery.level;
		print_battery(btpolicy_slot_kind(&policy, ev->slot), battery_of(&devices[ev->slot]));
		break;
	case BLE_FORGOTTEN:
		on_forgotten(ev);
		break;
	}
}

#define PASSKEY_LIMIT 1000000

static void open_pairing(const struct diag_request *req)
{
	uint32_t passkey;
	int err;

	if (core_radio_has_failed()) {
		diag_reply_error(req, DIAG_ERROR_RADIO, 0);
		return;
	}
	/* Only a pairing adds to the list, and it closes the window. */
	if (ble_stored_count() >= BTPOLICY_STORED_MAX) {
		diag_reply_error(req, DIAG_ERROR_LIST_FULL, 0);
		return;
	}
	sys_csrand_get(&passkey, sizeof(passkey));
	passkey %= PASSKEY_LIMIT;
	err = ble_offer_passkey(true, passkey);
	if (err) {
		printk("bluetooth passkey not offered: %d\n", err);
		diag_reply_error(req, DIAG_ERROR_RADIO, 0);
		return;
	}
	btpair_open_to_pick(&pair, k_uptime_get_32());
	core_log_pairing_opened();
	printk("pairing open for %u s\n", DIAG_PICK_WINDOW_MS / 1000);
	diag_reply(req, NULL, 0, DIAG_AFTER_NONE);
}

static void send_devices(const struct diag_request *req)
{
	static struct diag_device devices[BTPOLICY_STORED_MAX];
	const uint8_t *connected[DEVICE_SLOTS];
	size_t n;

	for (uint8_t s = 0; s < DEVICE_SLOTS; s++) {
		connected[s] = btpolicy_is_ready(&policy, s) ? btpolicy_peer(&policy, s) : NULL;
	}
	n = btlist_devices(&list, connected, ble_bond_secure, devices);
	core_reply_devices(req, devices, n);
}

static void forget_listed(const struct diag_request *req)
{
	uint8_t slot = btpolicy_slot_of(&policy, req->data);

	if (!btlist_has(&list, req->data)) {
		diag_reply_error(req, DIAG_ERROR_NO_SUCH_DEVICE, 0);
		return;
	}
	if (forget_answering || forget(slot, req->data, HISTORY_FORGOTTEN_ON_REQUEST) != 0) {
		diag_reply_error(req, DIAG_ERROR_STORE, 0);
		return;
	}
	forget_request = *req;
	forget_answering = true;
}

static void send_heard(const struct diag_request *req)
{
	struct diag_heard heard[BTSEEN_MAX];

	core_reply_heard(req, heard, btpair_heard(&pair, k_uptime_get_32(), heard));
}

static void pair_with(const struct diag_request *req)
{
	if (!btpair_pick(&pair, req->data, k_uptime_get_32())) {
		diag_reply_error(req, DIAG_ERROR_NO_SUCH_DEVICE, 0);
		return;
	}
	printk("bluetooth pairing picked a device\n");
	diag_reply(req, NULL, 0, DIAG_AFTER_NONE);
}

static void on_request(const struct diag_request *req)
{
	switch (req->command) {
	case DIAG_COMMAND_PAIR:
		open_pairing(req);
		break;
	case DIAG_COMMAND_DEVICES:
		send_devices(req);
		break;
	case DIAG_COMMAND_FORGET:
		forget_listed(req);
		break;
	case DIAG_COMMAND_HEARD:
		send_heard(req);
		break;
	case DIAG_COMMAND_PAIR_WITH:
		pair_with(req);
		break;
	default:
		diag_reply_error(req, DIAG_ERROR_UNKNOWN_COMMAND, 0);
		break;
	}
}

static void read_rssi(uint32_t now)
{
	if (now - rssi_tried_ms < RSSI_PERIOD_MS) {
		return;
	}
	rssi_tried_ms = now;
	for (uint8_t s = 0; s < DEVICE_SLOTS; s++) {
		int8_t dbm;

		if (!btpolicy_is_ready(&policy, s) || ble_rssi(s, &dbm) != 0) {
			continue;
		}
		core_rssi(s, dbm);
		devices[s].rssi = dbm;
		devices[s].rssi_read = true;
	}
}

static void run_hidpp(uint8_t slot, uint32_t now)
{
	struct hidpp *x = &runs[slot].hidpp;
	struct hidpp_event event;
	struct hidpp_msg m;

	if (!btpolicy_is_ready(&policy, slot) || !maps[slot].has_hidpp) {
		return;
	}
	hidpp_want_hires(x, usb_mouse_wheel_steps() != 1);
	if (hidpp_request(x, HIDPP_DEVICE_INDEX, now, HIDPP_RETRY_MS, &m)) {
		uint8_t data[HIDPP_LONG_LEN] = {0};

		hidpp_msg_write(&m, data, sizeof(data));
		/* A failed write counts as a try, so a report the device lacks ends the run. */
		ble_write_report(slot, HIDPP_LONG_REPORT_ID, data, sizeof(data));
		hidpp_taken(x, now);
	}
	if (hidpp_take_event(x, &event)) {
		core_log(slot, event.detail);
	}
}

FUNC_NORETURN void bluetooth_run(int store_err)
{
	int start_err;

	ARG_UNUSED(store_err);
	core_start_history(&loop);
	btpolicy_init(&policy);
	btpair_init(&pair);
	for (uint8_t s = 0; s < DEVICE_SLOTS; s++) {
		connection_over(s);
	}
	start_err = ble_start();
	if (start_err) {
		core_mark_radio_failed();
		printk("bluetooth start failed: %d\n", start_err);
	} else {
		load_list();
		btpolicy_seed_all(&policy, &list);
		printk("bluetooth started, %u stored\n", ble_stored_count());
	}

	for (;;) {
		struct diag_request req;
		struct ble_event ev;
		uint32_t now;
		uint8_t leds;

		/* A report must not wait out the tick. */
		for (k_timeout_t wait = K_MSEC(TICK_MS); ble_take_event(&ev, wait); wait = K_NO_WAIT) {
			on_event(&ev);
		}
		core_poll();
		while (core_take_request(&req)) {
			on_request(&req);
		}
		now = k_uptime_get_32();
		if (pairwin_ran_out(&pair.window, now)) {
			core_log_pairing_closed();
		}
		if (!btpair_is_open(&pair, now)) {
			ble_offer_passkey(false, 0);
		}
		read_rssi(now);
		for (uint8_t s = 0; s < DEVICE_SLOTS; s++) {
			run_hidpp(s, now);
		}
		if (!core_radio_has_failed()) {
			int err = ble_scan(btpolicy_scan(&policy, btpair_is_open(&pair, now), &list));

			if (err) {
				printk("bluetooth scan not switched: %d\n", err);
			}
		}
		if (core_take_leds(&leds)) {
			send_leds(leds);
		}
		core_show_state();
		core_watchdog_feed();
	}
}
```

## src/btlist.c
```c
#include <string.h>

#include "btlist.h"

#define NOT_LISTED UINT8_MAX

static uint8_t find(const struct btlist *l, const uint8_t *addr)
{
	for (uint8_t i = 0; i < l->count; i++) {
		if (memcmp(l->entries[i].addr, addr, BTPOLICY_ADDR_LEN) == 0) {
			return i;
		}
	}
	return NOT_LISTED;
}

static void remove_at(struct btlist *l, uint8_t at)
{
	memmove(&l->entries[at], &l->entries[at + 1],
		(l->count - at - 1) * sizeof(l->entries[0]));
	l->count--;
}

/* Puts the device's entry first, creating it if there is room; NULL when there is not. */
static struct btlist_entry *to_front(struct btlist *l, const uint8_t *addr, bool *changed)
{
	struct btlist_entry e = {0};
	uint8_t at = find(l, addr);

	if (at == NOT_LISTED) {
		if (l->count == BTPOLICY_STORED_MAX) {
			return NULL;
		}
		memcpy(e.addr, addr, BTPOLICY_ADDR_LEN);
		at = l->count++;
		*changed = true;
	} else {
		e = l->entries[at];
		*changed = at != 0;
	}
	memmove(&l->entries[1], &l->entries[0], at * sizeof(l->entries[0]));
	l->entries[0] = e;
	return &l->entries[0];
}

bool btlist_reconcile(struct btlist *l, const uint8_t addrs[][BTPOLICY_ADDR_LEN], size_t n)
{
	bool changed = false;

	for (uint8_t i = l->count; i-- > 0;) {
		bool bonded = false;

		for (size_t j = 0; j < n; j++) {
			bonded |= memcmp(l->entries[i].addr, addrs[j], BTPOLICY_ADDR_LEN) == 0;
		}
		if (!bonded) {
			remove_at(l, i);
			changed = true;
		}
	}
	for (size_t j = 0; j < n && l->count < BTPOLICY_STORED_MAX; j++) {
		if (find(l, addrs[j]) == NOT_LISTED) {
			l->entries[l->count] = (struct btlist_entry){0};
			memcpy(l->entries[l->count++].addr, addrs[j], BTPOLICY_ADDR_LEN);
			changed = true;
		}
	}
	return changed;
}

static bool set_name(struct btlist_entry *e, const char *name)
{
	char padded[BTLIST_NAME_LEN] = {0};

	strncpy(padded, name, sizeof(padded));
	if (memcmp(e->name, padded, sizeof(padded)) == 0) {
		return false;
	}
	memcpy(e->name, padded, sizeof(padded));
	return true;
}

bool btlist_connected(struct btlist *l, const uint8_t *addr, const char *name)
{
	bool changed = false;
	struct btlist_entry *e = to_front(l, addr, &changed);

	if (!e) {
		return false;
	}
	return set_name(e, name) || changed;
}

bool btlist_paired(struct btlist *l, const uint8_t *addr, enum device_kind kind, bool passkey_used,
		   bool bolt_mode, const char *name)
{
	uint8_t flags = (passkey_used ? 0 : BTLIST_NO_PASSKEY) | (bolt_mode ? BTLIST_BOLT : 0);
	bool changed = false;
	struct btlist_entry *e = to_front(l, addr, &changed);

	if (!e) {
		return false;
	}
	if (e->flags != flags || e->kind != kind) {
		e->flags = flags;
		e->kind = kind;
		changed = true;
	}
	if (name[0] != '\0' && set_name(e, name)) {
		changed = true;
	}
	return changed;
}

bool btlist_remove(struct btlist *l, const uint8_t *addr)
{
	uint8_t at = find(l, addr);

	if (at == NOT_LISTED) {
		return false;
	}
	remove_at(l, at);
	return true;
}

const struct btlist_entry *btlist_entry(const struct btlist *l, const uint8_t *addr)
{
	uint8_t at = addr ? find(l, addr) : NOT_LISTED;

	return at == NOT_LISTED ? NULL : &l->entries[at];
}

bool btlist_has(const struct btlist *l, const uint8_t *addr)
{
	return btlist_entry(l, addr) != NULL;
}

enum device_kind btlist_kind(const struct btlist *l, const uint8_t *addr)
{
	const struct btlist_entry *e = btlist_entry(l, addr);

	return e ? e->kind : DEVICE_NO_KIND;
}

_Static_assert(BTPOLICY_ADDR_LEN == DIAG_ADDR_LEN, "a device list carries the whole address");
_Static_assert(BTPOLICY_STORED_MAX <= DIAG_STORED_MAX, "a device list carries every device");

uint8_t btlist_pairing(const struct btlist_entry *e, bool secure)
{
	return diag_pairing(secure, !(e->flags & BTLIST_NO_PASSKEY),
			    e->flags & BTLIST_BOLT);
}

size_t btlist_devices(const struct btlist *l, const uint8_t *const connected[DEVICE_SLOTS],
		      bool (*secure)(const uint8_t addr[BTPOLICY_ADDR_LEN]),
		      struct diag_device out[BTPOLICY_STORED_MAX])
{
	for (uint8_t i = 0; i < l->count; i++) {
		const struct btlist_entry *e = &l->entries[i];

		out[i] = (struct diag_device){
			.kind = e->kind,
			.pairing = btlist_pairing(e, secure(e->addr)),
			.slot = DEVICE_NO_SLOT,
		};
		memcpy(out[i].addr, e->addr, sizeof(out[i].addr));
		memcpy(out[i].name, e->name, sizeof(out[i].name));
		for (uint8_t s = 0; s < DEVICE_SLOTS; s++) {
			if (connected[s] && memcmp(e->addr, connected[s], BTPOLICY_ADDR_LEN) == 0) {
				out[i].slot = s;
			}
		}
	}
	return l->count;
}
```

## src/btlist.h
```c
#ifndef BTLIST_H
#define BTLIST_H

#include <stdbool.h>
#include <stddef.h>
#include <stdint.h>

#include "btpolicy.h"
#include "device.h"

#define BTLIST_NAME_LEN DIAG_NAME_MAX

struct btlist_entry {
	uint8_t addr[BTPOLICY_ADDR_LEN];
	/* Padded with zeros; not terminated when it fills the field. */
	char name[BTLIST_NAME_LEN];
	uint8_t flags;
	/* An enum device_kind; zero, a keyboard, for an entry added by btlist_reconcile. */
	uint8_t kind;
};

/* A bool stored by earlier firmware reads as this bit. */
#define BTLIST_NO_PASSKEY 0x01
#define BTLIST_BOLT 0x02

/* The list is loaded from flash only when its size is unchanged. */
_Static_assert(sizeof(struct btlist_entry) == BTPOLICY_ADDR_LEN + BTLIST_NAME_LEN + 2,
	       "a stored entry keeps its layout");

/* The stored devices, the most recently connected first. */
struct btlist {
	struct btlist_entry entries[BTPOLICY_STORED_MAX];
	uint8_t count;
};

/* Each of these returns true when it changed the list. */

/* Drops the entries no bond backs and adds a nameless entry, last, for each bond without one. */
bool btlist_reconcile(struct btlist *l, const uint8_t addrs[][BTPOLICY_ADDR_LEN], size_t n);
/* Moves the device to the front and records its name. */
bool btlist_connected(struct btlist *l, const uint8_t *addr, const char *name);
/* Moves the device to the front and records its kind, how it paired and, unless empty, its name. */
bool btlist_paired(struct btlist *l, const uint8_t *addr, enum device_kind kind, bool passkey_used,
		   bool bolt_mode, const char *name);
bool btlist_remove(struct btlist *l, const uint8_t *addr);

/* NULL for an address not in the list, or a NULL address. */
const struct btlist_entry *btlist_entry(const struct btlist *l, const uint8_t *addr);
bool btlist_has(const struct btlist *l, const uint8_t *addr);
/* DEVICE_NO_KIND for an address not in the list. */
enum device_kind btlist_kind(const struct btlist *l, const uint8_t *addr);

/* secure tells whether the entry paired with LE Secure Connections. */
uint8_t btlist_pairing(const struct btlist_entry *e, bool secure);

/* connected[s] is the address of the device ready in slot s, or NULL; secure tells whether the
 * device at an address paired with LE Secure Connections. Returns the number of devices written. */
size_t btlist_devices(const struct btlist *l, const uint8_t *const connected[DEVICE_SLOTS],
		      bool (*secure)(const uint8_t addr[BTPOLICY_ADDR_LEN]),
		      struct diag_device out[BTPOLICY_STORED_MAX]);

#endif
```

## src/btpair.c
```c
#include <string.h>

#include "btpair.h"

enum btpair_state {
	BTPAIR_CLOSED,
	/* The new devices heard are listed until the user picks one. */
	BTPAIR_PICKING,
	BTPAIR_PICKED,
	/* A device waits for its passkey and holds the window open until its attempt ends. */
	BTPAIR_PASSKEY,
};

void btpair_init(struct btpair *p)
{
	*p = (struct btpair){0};
}

void btpair_open_to_pick(struct btpair *p, uint32_t now_ms)
{
	pairwin_open(&p->window, DIAG_PICK_WINDOW_MS, now_ms);
	p->picked = (struct diag_heard){0};
	btseen_clear(&p->seen);
}

static bool has_pick(const struct btpair *p)
{
	static const uint8_t none[BTPOLICY_ADDR_LEN];

	return memcmp(p->picked.addr, none, BTPOLICY_ADDR_LEN) != 0;
}

static enum btpair_state btpair_state(const struct btpair *p, uint32_t now_ms)
{
	if (!pairwin_is_open(&p->window, now_ms)) {
		return BTPAIR_CLOSED;
	}
	if (pairwin_holder(&p->window) != DEVICE_NO_SLOT) {
		return BTPAIR_PASSKEY;
	}
	return has_pick(p) ? BTPAIR_PICKED : BTPAIR_PICKING;
}

bool btpair_is_open(const struct btpair *p, uint32_t now_ms)
{
	return btpair_state(p, now_ms) != BTPAIR_CLOSED;
}

struct btpolicy_choice btpair_wants(struct btpair *p, const struct btpolicy *policy,
				    const struct btpolicy_advert *a, uint32_t now_ms)
{
	enum btpair_state state = btpair_state(p, now_ms);
	struct btpolicy_choice choice = btpolicy_wants(policy, a, state != BTPAIR_CLOSED, now_ms);

	if (a->stored || choice.want == BTPOLICY_IGNORE) {
		return choice;
	}
	if (state == BTPAIR_PICKING) {
		btseen_heard(&p->seen, a, now_ms);
		return BTPOLICY_CHOICE_IGNORE;
	}
	if (memcmp(p->picked.addr, a->addr, BTPOLICY_ADDR_LEN) != 0) {
		return BTPOLICY_CHOICE_IGNORE;
	}
	return choice;
}

size_t btpair_heard(const struct btpair *p, uint32_t now_ms, struct diag_heard out[BTSEEN_MAX])
{
	return btpair_state(p, now_ms) == BTPAIR_PICKING ? btseen_fresh(&p->seen, now_ms, out) : 0;
}

bool btpair_pick(struct btpair *p, const uint8_t addr[BTPOLICY_ADDR_LEN], uint32_t now_ms)
{
	const struct diag_heard *heard = btseen_find(&p->seen, addr, now_ms);

	if (btpair_state(p, now_ms) != BTPAIR_PICKING || heard == NULL) {
		return false;
	}
	p->picked = *heard;
	return true;
}

bool btpair_passkey_awaited(struct btpair *p, uint8_t slot, uint32_t passkey, bool clicked,
			    const char *name, uint32_t now_ms)
{
	if (!pairwin_hold(&p->window, slot, now_ms)) {
		return false;
	}
	p->passkey.value = passkey;
	p->passkey.clicked = clicked;
	p->passkey.entered = 0;
	strncpy((char *)p->passkey.name, name, sizeof(p->passkey.name));
	return true;
}

/* A device may send its keypress notifications in any order. */
static uint8_t entered(uint8_t n, enum btpolicy_keypress keypress)
{
	switch (keypress) {
	case BTPOLICY_KEY_ENTERED:
		return n < DIAG_CLICK_PASSKEY_BITS ? n + 1 : DIAG_CLICK_PASSKEY_BITS;
	case BTPOLICY_KEY_ERASED:
		return n > 0 ? n - 1 : 0;
	case BTPOLICY_ENTRY_COMPLETED:
		return DIAG_CLICK_PASSKEY_BITS;
	case BTPOLICY_ENTRY_STARTED:
	case BTPOLICY_ENTRY_CLEARED:
	default:
		return 0;
	}
}

bool btpair_keypress(struct btpair *p, uint8_t slot, enum btpolicy_keypress keypress)
{
	if (pairwin_holder(&p->window) != slot || !p->passkey.clicked) {
		return false;
	}
	p->passkey.entered = entered(p->passkey.entered, keypress);
	return true;
}

void btpair_paired(struct btpair *p, struct btpolicy *policy, uint8_t slot)
{
	pairwin_close(&p->window);
	btpolicy_paired(policy, slot);
}

bool btpair_attempt_failed(struct btpair *p, uint8_t slot, bool refused, uint32_t now_ms)
{
	if (refused && pairwin_is_open(&p->window, now_ms)) {
		pairwin_close(&p->window);
		return true;
	}
	return pairwin_end_attempt(&p->window, slot);
}

void btpair_status(const struct btpair *p, uint32_t now_ms, struct diag_status *st)
{
	st->passkey = 0;
	st->passkey_entered = 0;
	memset(st->pairing_name, 0, sizeof(st->pairing_name));
	switch (btpair_state(p, now_ms)) {
	case BTPAIR_CLOSED:
		st->pairing_window = DIAG_WINDOW_CLOSED;
		break;
	case BTPAIR_PICKING:
		st->pairing_window = DIAG_WINDOW_PICKING;
		break;
	case BTPAIR_PICKED:
		st->pairing_window = DIAG_WINDOW_PICKED;
		memcpy(st->pairing_name, p->picked.name, sizeof(st->pairing_name));
		break;
	case BTPAIR_PASSKEY:
		st->pairing_window = p->passkey.clicked ? DIAG_WINDOW_PASSKEY_CLICKED
							: DIAG_WINDOW_PASSKEY_AWAITED;
		st->passkey = p->passkey.value;
		st->passkey_entered = p->passkey.entered;
		memcpy(st->pairing_name, p->passkey.name, sizeof(st->pairing_name));
		break;
	}
}
```

## src/btpair.h
```c
#ifndef BTPAIR_H
#define BTPAIR_H

#include <stdbool.h>
#include <stddef.h>
#include <stdint.h>

#include "btpolicy.h"
#include "btseen.h"
#include "pairwin.h"

struct btpair {
	/* A device holding it open waits for its passkey. */
	struct pairwin window;
	struct btseen seen;
	/* Holds the picked device from the pick until the window opens again; all zero before a
	 * pick. */
	struct diag_heard picked;
	struct {
		uint32_t value;
		bool clicked;
		uint8_t entered;
		uint8_t name[DIAG_NAME_MAX];
	} passkey;
};

void btpair_init(struct btpair *p);
/* Stays open for DIAG_PICK_WINDOW_MS, or while a device it took waits for its passkey. */
void btpair_open_to_pick(struct btpair *p, uint32_t now_ms);
bool btpair_is_open(const struct btpair *p, uint32_t now_ms);
/* btpolicy_wants with the window's rules for a new device: one heard while picking is listed, and
 * only the picked one is wanted. */
struct btpolicy_choice btpair_wants(struct btpair *p, const struct btpolicy *policy,
				    const struct btpolicy_advert *a, uint32_t now_ms);
/* Writes the devices listed while picking, in the order they were first heard, and returns how
 * many. */
size_t btpair_heard(const struct btpair *p, uint32_t now_ms, struct diag_heard out[BTSEEN_MAX]);
/* Picks a device listed within BTSEEN_FRESH_MS; false outside picking or for any other device. */
bool btpair_pick(struct btpair *p, const uint8_t addr[BTPOLICY_ADDR_LEN], uint32_t now_ms);
/* Returns false and does nothing in a closed window. */
bool btpair_passkey_awaited(struct btpair *p, uint8_t slot, uint32_t passkey, bool clicked,
			    const char *name, uint32_t now_ms);
/* Counts a click of the device that waits for a clicked passkey, and returns whether it did. */
bool btpair_keypress(struct btpair *p, uint8_t slot, enum btpolicy_keypress keypress);
/* Closes the window and tells the policy. */
void btpair_paired(struct btpair *p, struct btpolicy *policy, uint8_t slot);
/* Closes the window when the picked device refused or a device held it for its passkey; returns
 * whether it closed an open window. */
bool btpair_attempt_failed(struct btpair *p, uint8_t slot, bool refused, uint32_t now_ms);
/* Fills the status's pairing window, passkey, entered clicks and device name. */
void btpair_status(const struct btpair *p, uint32_t now_ms, struct diag_status *st);

#endif
```

## src/btseen.c
```c
#include <string.h>

#include "btseen.h"

_Static_assert(BTPOLICY_ADDR_LEN == DIAG_ADDR_LEN, "a heard record carries the whole address");

void btseen_clear(struct btseen *s)
{
	s->count = 0;
}

static bool fresh(const struct btseen *s, uint8_t i, uint32_t now_ms)
{
	return now_ms - s->devices[i].heard_ms < BTSEEN_FRESH_MS;
}

static uint8_t index_of(const struct btseen *s, const uint8_t *addr)
{
	for (uint8_t i = 0; i < s->count; i++) {
		if (memcmp(s->devices[i].heard.addr, addr, BTPOLICY_ADDR_LEN) == 0) {
			return i;
		}
	}
	return BTSEEN_MAX;
}

static uint8_t slot_for(struct btseen *s, const uint8_t *addr, uint32_t now_ms)
{
	uint8_t at = index_of(s, addr);

	if (at < BTSEEN_MAX) {
		return at;
	}
	if (s->count < BTSEEN_MAX) {
		at = s->count++;
	} else {
		at = 0;
		for (uint8_t i = 1; i < s->count; i++) {
			if (now_ms - s->devices[i].heard_ms > now_ms - s->devices[at].heard_ms) {
				at = i;
			}
		}
	}
	s->devices[at].heard = (struct diag_heard){0};
	memcpy(s->devices[at].heard.addr, addr, BTPOLICY_ADDR_LEN);
	return at;
}

void btseen_heard(struct btseen *s, const struct btpolicy_advert *a, uint32_t now_ms)
{
	uint8_t at = slot_for(s, a->addr, now_ms);
	struct diag_heard *h = &s->devices[at].heard;

	s->devices[at].heard_ms = now_ms;
	h->kind = a->kind;
	h->flags |= a->bolt ? DIAG_HEARD_BOLT : 0;
	h->rssi = a->rssi;
	if (a->name[0] != '\0') {
		strncpy((char *)h->name, a->name, sizeof(h->name));
	}
}

size_t btseen_fresh(const struct btseen *s, uint32_t now_ms, struct diag_heard out[BTSEEN_MAX])
{
	size_t n = 0;

	for (uint8_t i = 0; i < s->count; i++) {
		if (fresh(s, i, now_ms)) {
			out[n++] = s->devices[i].heard;
		}
	}
	return n;
}

const struct diag_heard *btseen_find(const struct btseen *s, const uint8_t addr[BTPOLICY_ADDR_LEN],
				     uint32_t now_ms)
{
	uint8_t at = index_of(s, addr);

	return at < BTSEEN_MAX && fresh(s, at, now_ms) ? &s->devices[at].heard : NULL;
}
```
